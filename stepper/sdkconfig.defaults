## stepper/sdkconfig.defaults
```kconfig
# Stepper Project - sdkconfig.defaults
# Target configuration for ESP32-S3

# Target
CONFIG_IDF_TARGET="esp32s3"

# WiFi Configuration
CONFIG_ESP_WIFI_SOFTAP_SUPPORT=y
CONFIG_ESP_WIFI_STATIC_RX_BUFFER_NUM=10
CONFIG_ESP_WIFI_DYNAMIC_RX_BUFFER_NUM=32
CONFIG_ESP_WIFI_TX_BUFFER_TYPE=0

# LWIP Configuration
CONFIG_LWIP_SNTP_MAX_SERVERS=3
CONFIG_LWIP_DNS_MAX_SERVERS=3

# HTTP Server (for captive portal)
CONFIG_HTTPD_MAX_REQ_HDR_LEN=1024
CONFIG_HTTPD_MAX_URI_LEN=512

# OTA Configuration
CONFIG_BOOTLOADER_APP_ROLLBACK_ENABLE=y

# Flash Configuration
CONFIG_ESPTOOLPY_FLASHSIZE_16MB=y
CONFIG_ESPTOOLPY_FLASHFREQ="80m"
CONFIG_ESPTOOLPY_FLASHMODE="dio"

# Partition table configuration
CONFIG_PARTITION_TABLE_CUSTOM=y
CONFIG_PARTITION_TABLE_CUSTOM_FILENAME="partitions.csv"

# LVGL Configuration
CONFIG_LV_COLOR_DEPTH_16=y
CONFIG_LV_USE_PERF_MONITOR=n
CONFIG_LV_USE_MEM_MONITOR=n
CONFIG_LV_TICK_CUSTOM=y
CONFIG_LV_TICK_CUSTOM_INCLUDE="esp_timer.h"
CONFIG_LV_TICK_CUSTOM_SYS_TIME_EXPR="(esp_timer_get_time() / 1000LL)"

# LVGL Fonts - Enable larger fonts for better readability
CONFIG_LV_FONT_MONTSERRAT_14=y
CONFIG_LV_FONT_MONTSERRAT_20=y
CONFIG_LV_FONT_MONTSERRAT_28=y
CONFIG_LV_FONT_MONTSERRAT_48=y

# Logging
CONFIG_LOG_DEFAULT_LEVEL_INFO=y

# Main task stack size (increased for WiFi operations)
CONFIG_ESP_MAIN_TASK_STACK_SIZE=8192

# NVS Configuration
CONFIG_NVS_ENCRYPTION=n

# FreeRTOS
CONFIG_FREERTOS_HZ=1000

# Memory - ESP32-S3 with Octal PSRAM
CONFIG_SPIRAM=y
CONFIG_SPIRAM_MODE_OCT=y
CONFIG_SPIRAM_SPEED_80M=y

# USB Serial
CONFIG_ESP_CONSOLE_USB_CDC=y
CONFIG_ESP_CONSOLE_USB_SERIAL_JTAG=y
```
